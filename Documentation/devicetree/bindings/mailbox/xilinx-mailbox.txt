## Documentation/devicetree/bindings/mailbox/xilinx-mailbox.txt
```
Xilinx Mailbox Driver
=====================

Required properties:
- compatible       : "xlnx,mailbox-2.1".
- reg              :  physical base address of the mailbox and length of
                      memory mapped region.
- #mbox-cells      :  common mailbox binding property to identify the number
                      of cells required for the mailbox specifier, should be 1
- clocks           :  phandle to clock provider
- clock-names      :  must be 'mbox'

Optional properties:
- interrupt-parent : interrupt source phandle
- interrupts       : interrupt number, The interrupt specifier format
                     depends on the interrupt controller parent.

Example:
	mbox: mailbox@40400000 {
		compatible = "xlnx,mailbox-2.1";
		reg = <0x40400000 0x100>;
		interrupt-parent = <&intc>;
		interrupts = <5>;
		#mbox-cells = <0>;
		clocks = <&clkc 15>;
		clock-names = "mbox";
	};

Mailbox client
===============
"mboxes" and the optional "mbox-names" (please see
Documentation/devicetree/bindings/mailbox/mailbox.txt for details). Each value
of the mboxes property should contain a phandle to the mailbox controller
device node and second argument is the channel index. It must be 0 (hardware
support only one channel). The equivalent "mbox-names" property value can be
used to give a name to the communication channel to be used by the client user.

Example:
	mclient0: mclient0@400 {
		compatible = "client-1.0";
		reg = <0x400 0x10>;
		mbox-names = "mbox";
		mboxes = <&mbox 0>;
	};
```

## Documentation/devicetree/bindings/mfd/ds1374.txt
```
* Device tree bindings for Maxim/Dallas DS1374 Multi Function Device (MFD)

The Maxim/Dallas DS1374 is a multi function device that combines rtc,
watchdog or alarm, as well as trickle charger.

The DS1374 is connected via I2C.

Required properties:
- compatible: "dallas,ds1374"
- reg: I2C slave address
- dallas,mode: Should be one of the following values:
			<0> for RTC
			<1> for RTC + Alarm (Interrupt)
			<2> for RTC + Watchdog

For convenience there's an include file with constants avaialable
at include/dt-bindings/mfd/ds1374.h

Required child:
A single available child device of type matching the "dallas,mode"
property.

See ../watchdog/* for generic watchdog bindings.

Optional properties (real time clock):
- interrupt: phandle to interrupt cell for the rtc's alarm feature

See ../rtc/* for generic rtc bindings.

Optional properties (trickle-charger):
- dallas,trickle-resistor-ohms : Selected resistor for trickle charger
	Values usable for ds1374 are 250, 2000, 4000
	Should be given if trickle charger should be enabled
- dallas,trickle-diode-disable : Do not use internal trickle charger diode
	Should be given if internal trickle charger diode should be disabled

Optional properties (watchdog):
- dallas,remap-reset : If present, the INT pin of the device will toggle on
	watchdog timeout instead of the RST pin. This effectively muxes the
	INT pin to the RST pin.

Example for just rtc:

i2c@12ca0000 {
	rtc@68 {
		compatible = "ds1374";
		reg = <0x68>;
		dallas,mode = <0>
	};
};

Example for rtc with alarm mode and interrupt (and trickle charging):

i2c@12ca0000 {
	rtc@68 {
		compatible = "ds1374";
		reg = <0x68>;
		interrupts = <&gpio0 62>;
		dallas,mode = <1>

		dallas,trickle-resistor-ohms = <250>;
		dallas,trickle-diode-disable;
	};
};

Example for rtc with watchdog and reset on timeout, with watchdog reset
remapped to the INT pin (also no trickle charging):

i2c@12ca0000 {
	rtc@68 {
		compatible = "ds1374";
		reg = <0x68>;
		dallas,mode = <2>
		dallas,remap-reset;
		reset-on-timeout;
	};
};

Example for rtc with watchdog and reset on timeout, with reset not
remapped to the INT pin (also no trickle charging):

i2c@12ca0000 {
	rtc@68 {
		compatible = "ds1374";
		reg = <0x68>;
		dallas,mode = <2>
	};
};
```

## Documentation/devicetree/bindings/rtc/dallas,ds1374.txt
```
* Dallas DS1374		I2C Real-Time Clock / WDT

Required properties:
- compatible: Should contain "dallas,ds1374".
- reg: I2C address for chip

Optional properties:
- trickle-resistor-ohms : Selected resistor for trickle charger
	Values usable for ds1374 are 250, 2000, 4000
	Should be given if trickle charger should be enabled
- trickle-diode-disable : Do not use internal trickle charger diode
	Should be given if internal trickle charger diode should be disabled
Example:
	ds1374: rtc@0 {
		compatible = "dallas,ds1374";
		trickle-resistor-ohms = <250>;
		reg = <0>;
	};
```
